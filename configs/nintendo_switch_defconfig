## configs/nintendo_switch_defconfig
```kconfig
CONFIG_ANY_TOOLCHAIN=y
CONFIG_USE_BLOBS=y
CONFIG_VENDOR_NINTENDO=y
# CONFIG_POST_DEVICE is not set
CONFIG_COREBOOT_ROMSIZE_KB_1024=y
CONFIG_CONSOLE_SERIAL_TEGRA210_UARTB=y
CONFIG_DEFAULT_CONSOLE_LOGLEVEL_6=y
CONFIG_PAYLOAD_ELF=y
CONFIG_PAYLOAD_FILE="../switch-uboot/u-boot.elf"
CONFIG_SC7ENTRY_FILE="../Atmosphere/exosphere/sc7fw/sc7fw.bin"
CONFIG_WARMBOOT_FILE="src/soc/nvidia/tegra210/lp0/sc7_exit/tegra_sc7_exit.fw"
CONFIG_REBOOTSTUB_FILE="src/soc/nvidia/tegra210/lp0/rebootstub/tegra_rebootstub.fw"
```
